## Kconfig
```kconfig
# Copyright (c) 2025 sekigon-gonnoc
# SPDX-License-Identifier: MIT

menuconfig ZMK_STATUS_LED
    bool "ZMK Status LED indicator"
    help
      Enable status LED indicators for ZMK.

if ZMK_STATUS_LED

config ZMK_STATUS_LED_BATTERY_LEVEL
    bool "Show battery level at startup"
    default y
    help
      Show battery level with 1-3 blinks at keyboard startup.

config ZMK_STATUS_LED_ADVERTISING
    bool "Blink LED during Bluetooth advertising"
    depends on BT
    default y
    help
      Blink the LED when the keyboard is advertising.

config ZMK_STATUS_LED_CONNECTED
    bool "Flash LED on Bluetooth connection"
    depends on BT
    default y
    help
      Flash the LED briefly when a Bluetooth connection is established.

config ZMK_STATUS_LED_BLINK_MS
    int "LED blink duration in ms"
    default 70
    help
      Duration of each blink in milliseconds for advertising.

config ZMK_STATUS_LED_PAUSE_MS
    int "Pause between LED blinks in ms"
    default 50
    help
      Duration of pause between blinks in milliseconds for advertising.

config ZMK_STATUS_LED_ADVERTISING_INTERVAL_MS
    int "Interval between advertising blinks in ms"
    default 3000
    help
      Duration between advertising blinks in milliseconds.

config ZMK_STATUS_LED_CONNECTED_MS
    int "Connected indication duration in ms"
    default 1000
    help
      Duration of the connected indication in milliseconds.

config ZMK_STATUS_LED_BATTERY_BLINK_MS
    int "Battery level blink duration in ms"
    default 100
    help
      Duration of each blink in milliseconds for battery level indication.

config ZMK_STATUS_LED_BATTERY_PAUSE_MS
    int "Pause between battery level blinks in ms"
    default 150
    help
      Duration of pause between blinks in milliseconds for battery level indication.

endif # ZMK_STATUS_LED
```
